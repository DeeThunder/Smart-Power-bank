## sdkconfig.defaults
```kconfig
# Bluetooth
CONFIG_BT_ENABLED=y
CONFIG_BT_NIMBLE_ENABLED=y
CONFIG_BT_BLUEDROID_ENABLED=n

# NimBLE Options
CONFIG_BT_NIMBLE_MAX_CONNECTIONS=1
CONFIG_BT_NIMBLE_SVC_GAP_DEVICE_NAME="Nexus Power"
CONFIG_BT_NIMBLE_LOG_LEVEL_INFO=y

# Memory Management
CONFIG_BT_NIMBLE_MEM_ALLOC_MODE_INTERNAL=y
```
